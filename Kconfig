## drivers/spi_ext_mutex/Kconfig
```kconfig
# Copyright (c) 2017 - 2018, Nordic Semiconductor ASA
# SPDX-License-Identifier: Apache-2.0


menu "nrfx drivers"
	depends on HAS_NRFX

config NRFX_SPIM_EXT_MUTEX
	bool "Enable SPIM driver"
	depends on HAS_HW_NRF_SPIM0 || HAS_HW_NRF_SPIM1 || \
		   HAS_HW_NRF_SPIM2 || HAS_HW_NRF_SPIM3 || HAS_HW_NRF_SPIM4
	# select this so that one file is compiled from the zephyr spi options
	select NRFX_SPIM

config NRFX_SPIM0_EXT_MUTEX
	bool "Enable SPIM0 instance"
	depends on HAS_HW_NRF_SPIM0
	select NRFX_SPIM_EXT_MUTEX

config NRFX_SPIM1_EXT_MUTEX
	bool "Enable SPIM1 instance"
	depends on HAS_HW_NRF_SPIM1
	select NRFX_SPIM_EXT_MUTEX

config NRFX_SPIM2_EXT_MUTEX
	bool "Enable SPIM2 instance"
	depends on HAS_HW_NRF_SPIM2
	select NRFX_SPIM_EXT_MUTEX

config NRFX_SPIM3_EXT_MUTEX
	bool "Enable SPIM3 instance"
	depends on HAS_HW_NRF_SPIM3
	select NRFX_SPIM_EXT_MUTEX

config NRFX_SPIM4_EXT_MUTEX
	bool "Enable SPIM4 instance"
	depends on HAS_HW_NRF_SPIM4
	select NRFX_SPIM_EXT_MUTEX

endmenu

if SPI_NRFX

# Workaround for not being able to have commas in macro arguments
DT_COMPAT_NORDIC_NRF_SPIM_EXT_MUTEX := nordic,nrf-spim-ext-mutex

config SPI_0_NRF_SPIM_EXT_MUTEX
	def_bool $(dt_nodelabel_has_compat,spi0,$(DT_COMPAT_NORDIC_NRF_SPIM_EXT_MUTEX))
	# This driver is not available for nRF52832 because of Product Anomaly 58
	# (SPIM: An additional byte is clocked out when RXD.MAXCNT == 1 and TXD.MAXCNT <= 1)
	# Allow the 'EasyDMA' driver only if this automatic safety-disable is overridden
	depends on (!SOC_NRF52832 || SOC_NRF52832_ALLOW_SPIM_DESPITE_PAN_58)
	select NRFX_SPIM0_EXT_MUTEX
	select NRFX_SPIM0
	help
	  Enable nRF SPI Master with EasyDMA on port 0.

config SPI_1_NRF_SPIM_EXT_MUTEX
	def_bool $(dt_nodelabel_has_compat,spi1,$(DT_COMPAT_NORDIC_NRF_SPIM_EXT_MUTEX))
	# This driver is not available for nRF52832 because of Product Anomaly 58
	# (SPIM: An additional byte is clocked out when RXD.MAXCNT == 1 and TXD.MAXCNT <= 1)
	# Allow the 'EasyDMA' driver only if this automatic safety-disable is overridden
	depends on (!SOC_NRF52832 || SOC_NRF52832_ALLOW_SPIM_DESPITE_PAN_58)
	select NRFX_SPIM1_EXT_MUTEX
	select NRFX_SPIM1
	help
	  Enable nRF SPI Master with EasyDMA on port 1.

config SPI_2_NRF_SPIM_EXT_MUTEX
	def_bool $(dt_nodelabel_has_compat,spi2,$(DT_COMPAT_NORDIC_NRF_SPIM_EXT_MUTEX))
	# This driver is not available for nRF52832 because of Product Anomaly 58
	# (SPIM: An additional byte is clocked out when RXD.MAXCNT == 1 and TXD.MAXCNT <= 1)
	# Allow the 'EasyDMA' driver only if this automatic safety-disable is overridden
	depends on (!SOC_NRF52832 || SOC_NRF52832_ALLOW_SPIM_DESPITE_PAN_58)
	select NRFX_SPIM2_EXT_MUTEX
	select NRFX_SPIM2
	help
	  Enable nRF SPI Master with EasyDMA on port 2.

config SPI_3_NRF_SPIM_EXT_MUTEX
	def_bool $(dt_nodelabel_has_compat,spi3,$(DT_COMPAT_NORDIC_NRF_SPIM_EXT_MUTEX))
	select NRFX_SPIM3_EXT_MUTEX
	select NRFX_SPIM3
	help
	  Enable nRF SPI Master with EasyDMA on port 3.

config SPI_4_NRF_SPIM_EXT_MUTEX
	def_bool $(dt_nodelabel_has_compat,spi4,$(DT_COMPAT_NORDIC_NRF_SPIM_EXT_MUTEX))
	select NRFX_SPIM4_EXT_MUTEX
	select NRFX_SPIM4
	help
	  Enable nRF SPI Master with EasyDMA on port 4.

config SPI_0_NRF_ORC
	hex "SPI Port 0 over-read character"
	depends on SPI_0_NRF_SPIM_EXT_MUTEX
	range 0x00 0xff
	default 0xff
	help
	  Over-read character. Character clocked out after an over-read
	  of the transmit buffer.

config SPI_1_NRF_ORC
	hex "SPI Port 1 over-read character"
	depends on SPI_1_NRF_SPIM_EXT_MUTEX
	range 0x00 0xff
	default 0xff
	help
	  Over-read character. Character clocked out after an over-read
	  of the transmit buffer.

config SPI_2_NRF_ORC
	hex "SPI Port 2 over-read character"
	depends on SPI_2_NRF_SPIM_EXT_MUTEX
	range 0x00 0xff
	default 0xff
	help
	  Over-read character. Character clocked out after an over-read
	  of the transmit buffer.

config SPI_3_NRF_ORC
	hex "SPI Port 3 over-read character"
	depends on SPI_3_NRF_SPIM_EXT_MUTEX
	range 0x00 0xff
	default 0xff
	help
	  Over-read character. Character clocked out after an over-read
	  of the transmit buffer.

config SPI_4_NRF_ORC
	hex "SPI Port 4 over-read character"
	depends on SPI_4_NRF_SPIM_EXT_MUTEX
	range 0x00 0xff
	default 0xff
	help
	  Over-read character. Character clocked out after an over-read
	  of the transmit buffer.

config SPI_NRFX_RAM_BUFFER_SIZE
	int "Size of RAM buffers for SPIM peripherals"
	default 8
	depends on NRFX_SPIM_EXT_MUTEX
	help
	  SPIM peripherals cannot transmit data directly from flash. Therefore,
	  a buffer in RAM needs to be provided for each instance of SPI driver
	  using SPIM peripheral, so that the driver can copy there a chunk of
	  data from flash and transmit it.
	  The size is specified in bytes. A size of 0 means that this feature
	  should be disabled, and the application must then take care of not
	  supplying buffers located in flash to the driver, otherwise such
	  transfers will fail.

config NRFX_SPIM_EXT_MUTEX_ACQUIRE_TIMEOUT_MS
	int "Acquire timeout for external mutex"
	default 2000
	depends on NRFX_SPIM_EXT_MUTEX
	help
	  The maximum time in ms to wait for the other MCU to release the mutex

config NRFX_SPIM_EXT_MUTEX_CS_COUNT
	int "Number of peripherals attached to spi from this controller which have a chip select pin configured"
	range 1 8
	depends on NRFX_SPIM_EXT_MUTEX
	help
	  Number of peripherals attached to spi from this controller which have a chip select pin configured


endif # SPI_NRFX
```

## dts/bindings/irnas,nrf-spim-ext-mutex.yaml
```yaml
# Copyright (c) 2019 Nordic Semiconductor ASA
# SPDX-License-Identifier: Apache-2.0

description: Nordic nRF family SPIM (SPI master with EasyDMA) with external mutex support

compatible: "irnas,nrf-spim-ext-mutex"

include: nordic,nrf-spi-common.yaml

properties:
    miso-pull-up:
      type: boolean
      required: false
      description: Enable pull-up on MISO line

    miso-pull-down:
      type: boolean
      required: false
      description: Enable pull-down on MISO line

    signal-gpios:
      type: phandle-array
      required: true
      description: |
        GPIO responsible for signaling request to use from MCU1 to MCU2 (and vice versa)

    mutex-role:
      type: string
      required: true
      enum:
        - "master"
        - "slave"
      description: |
        Mutex role for MCU. One should be configured to "master" and the other to "slave".
        The one that uses spi more often should be configured to "master"
```
